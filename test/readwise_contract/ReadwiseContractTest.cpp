// Guards the Readwise Reader API contract documented in
// docs/readwise-api-contract.md.
//
// The point of these tests is not to validate JSON. It is to prove, against
// sanitized captures of real API responses, that the firmware can consume those
// responses incrementally — because on an ESP32-C3 with ~380 KB of RAM, a
// single list page (135 KB) or a single article body (88 KB) cannot be buffered
// whole. Every fixture is therefore fed through StreamingJsonParser in small
// chunks, and the resulting event stream is required to be identical to a
// single-shot feed.
//
// Fixtures are generated by scripts/readwise_sanitize.py from raw output of
// scripts/readwise_probe.py. Never hand-edit them, and never regenerate them
// from an unsanitized capture.

#include <gtest/gtest.h>

#include <cstring>
#include <fstream>
#include <sstream>
#include <string>
#include <vector>

#include "lib/JsonParser/StreamingJsonParser.h"

#ifndef READWISE_FIXTURES_DIR
#error "READWISE_FIXTURES_DIR must be defined by the build"
#endif

namespace {

enum class EventType {
  KEY,
  STRING,
  NUMBER,
  BOOL_TRUE,
  BOOL_FALSE,
  NULL_VAL,
  OBJECT_START,
  OBJECT_END,
  ARRAY_START,
  ARRAY_END,
};

struct Event {
  EventType type;
  std::string value;

  bool operator==(const Event& other) const { return type == other.type && value == other.value; }
};

struct Recorder {
  std::vector<Event> events;
};

void onKey(void* ctx, const char* key, size_t len) {
  static_cast<Recorder*>(ctx)->events.push_back({EventType::KEY, std::string(key, len)});
}
void onString(void* ctx, const char* value, size_t len) {
  static_cast<Recorder*>(ctx)->events.push_back({EventType::STRING, std::string(value, len)});
}
void onNumber(void* ctx, const char* value, size_t len) {
  static_cast<Recorder*>(ctx)->events.push_back({EventType::NUMBER, std::string(value, len)});
}
void onBool(void* ctx, bool value) {
  static_cast<Recorder*>(ctx)->events.push_back({value ? EventType::BOOL_TRUE : EventType::BOOL_FALSE, {}});
}
void onNull(void* ctx) { static_cast<Recorder*>(ctx)->events.push_back({EventType::NULL_VAL, {}}); }
void onObjectStart(void* ctx) { static_cast<Recorder*>(ctx)->events.push_back({EventType::OBJECT_START, {}}); }
void onObjectEnd(void* ctx) { static_cast<Recorder*>(ctx)->events.push_back({EventType::OBJECT_END, {}}); }
void onArrayStart(void* ctx) { static_cast<Recorder*>(ctx)->events.push_back({EventType::ARRAY_START, {}}); }
void onArrayEnd(void* ctx) { static_cast<Recorder*>(ctx)->events.push_back({EventType::ARRAY_END, {}}); }

JsonCallbacks makeCallbacks(Recorder* ctx) {
  return {ctx, onKey, onString, onNumber, onBool, onNull, onObjectStart, onObjectEnd, onArrayStart, onArrayEnd};
}

std::string loadFixture(const std::string& name) {
  const std::string path = std::string(READWISE_FIXTURES_DIR) + "/" + name;
  std::ifstream file(path, std::ios::binary);
  EXPECT_TRUE(file.is_open()) << "missing fixture: " << path;
  std::ostringstream buffer;
  buffer << file.rdbuf();
  return buffer.str();
}

// Feeds the payload in fixed-size chunks, mimicking the HttpDownloader data
// callback, which delivers arbitrary TLS record-sized fragments.
std::vector<Event> parseChunked(const std::string& json, size_t chunkSize, bool* errorOut = nullptr) {
  Recorder recorder;
  StreamingJsonParser parser(makeCallbacks(&recorder));
  for (size_t offset = 0; offset < json.size(); offset += chunkSize) {
    const size_t len = std::min(chunkSize, json.size() - offset);
    parser.feed(json.data() + offset, len);
  }
  if (errorOut != nullptr) {
    *errorOut = parser.hasError();
  }
  return recorder.events;
}

const char* const kAllFixtures[] = {
    "list_normal.json", "list_optional_fields.json", "list_oversized_content.json",
    "list_page1.json",  "list_page2.json",           "list_unicode.json",
    "list_empty.json",  "delete_then_list.json",     "error_401.json",
    "error_429.json",   "update_response.json",      "highlights_create.json",
};

// Collects the string/number value that followed a given key.
std::string valueAfterKey(const std::vector<Event>& events, const std::string& key) {
  for (size_t i = 0; i + 1 < events.size(); ++i) {
    if (events[i].type == EventType::KEY && events[i].value == key) {
      return events[i + 1].value;
    }
  }
  return {};
}

size_t countKey(const std::vector<Event>& events, const std::string& key) {
  size_t count = 0;
  for (const Event& event : events) {
    if (event.type == EventType::KEY && event.value == key) {
      ++count;
    }
  }
  return count;
}

}  // namespace

// Every fixture must parse cleanly when delivered 64 bytes at a time. This is
// the core claim issue #2 asks to verify: the responses can be consumed
// incrementally under the firmware's memory ceiling.
TEST(ReadwiseContract, AllFixturesParseInSmallChunks) {
  for (const char* name : kAllFixtures) {
    const std::string json = loadFixture(name);
    ASSERT_FALSE(json.empty()) << name;

    bool error = false;
    const std::vector<Event> events = parseChunked(json, 64, &error);
    EXPECT_FALSE(error) << "parse error in " << name;
    EXPECT_FALSE(events.empty()) << "no events from " << name;
  }
}

// Chunk boundaries must not change what the parser reports. A boundary landing
// mid-token, mid-escape, or mid-UTF-8-sequence is the realistic failure mode
// over TLS, so several sizes are compared against a single-shot feed.
TEST(ReadwiseContract, ChunkBoundariesDoNotChangeEvents) {
  for (const char* name : kAllFixtures) {
    const std::string json = loadFixture(name);
    const std::vector<Event> reference = parseChunked(json, json.size());

    for (size_t chunkSize : {size_t{1}, size_t{7}, size_t{64}, size_t{512}, size_t{4096}}) {
      const std::vector<Event> chunked = parseChunked(json, chunkSize);
      EXPECT_EQ(reference, chunked) << "chunk size " << chunkSize << " changed the event stream for " << name;
    }
  }
}

// Pagination contract: a non-final page carries a cursor string, the final page
// carries null. The client stops when it sees the null.
TEST(ReadwiseContract, PaginationCursorSignalsLastPage) {
  const std::vector<Event> page1 = parseChunked(loadFixture("list_page1.json"), 64);
  const std::vector<Event> page2 = parseChunked(loadFixture("list_page2.json"), 64);

  ASSERT_EQ(countKey(page1, "nextPageCursor"), 1u);
  ASSERT_EQ(countKey(page2, "nextPageCursor"), 1u);

  for (size_t i = 0; i + 1 < page1.size(); ++i) {
    if (page1[i].type == EventType::KEY && page1[i].value == "nextPageCursor") {
      EXPECT_EQ(page1[i + 1].type, EventType::STRING) << "non-final page must carry a cursor";
      EXPECT_FALSE(page1[i + 1].value.empty());
    }
  }
  for (size_t i = 0; i + 1 < page2.size(); ++i) {
    if (page2[i].type == EventType::KEY && page2[i].value == "nextPageCursor") {
      EXPECT_EQ(page2[i + 1].type, EventType::NULL_VAL) << "final page must carry a null cursor";
    }
  }
}

// An empty incremental result is {"count":0,"nextPageCursor":null,"results":[]}
// rather than an error, so a no-op sync must not be treated as a failure.
TEST(ReadwiseContract, EmptyResultIsWellFormed) {
  const std::vector<Event> events = parseChunked(loadFixture("list_empty.json"), 64);
  EXPECT_EQ(valueAfterKey(events, "count"), "0");
  EXPECT_EQ(countKey(events, "results"), 1u);
}

// Optional fields arrive as JSON null, not as absent keys. The client must
// handle a null for every one of these rather than assuming a string.
TEST(ReadwiseContract, OptionalFieldsArriveAsNull) {
  const std::vector<Event> events = parseChunked(loadFixture("list_optional_fields.json"), 64);

  bool sawNullValue = false;
  for (size_t i = 0; i + 1 < events.size(); ++i) {
    if (events[i].type != EventType::KEY) {
      continue;
    }
    const std::string& key = events[i].value;
    const bool nullable = key == "title" || key == "author" || key == "site_name" || key == "published_date" ||
                          key == "location" || key == "word_count" || key == "summary" || key == "image_url";
    if (nullable && events[i + 1].type == EventType::NULL_VAL) {
      sawNullValue = true;
    }
  }
  EXPECT_TRUE(sawNullValue) << "fixture no longer exercises nullable fields";
}

// Regression guard for the field types that contradict Readwise's published
// documentation. If any of these change shape, the firmware's parser
// assumptions in docs/readwise-api-contract.md need revisiting.
TEST(ReadwiseContract, DocumentedFieldShapesHold) {
  const std::vector<Event> events = parseChunked(loadFixture("list_normal.json"), 64);

  // reading_time is a human string ("25 mins"), not an integer.
  for (size_t i = 0; i + 1 < events.size(); ++i) {
    if (events[i].type == EventType::KEY && events[i].value == "reading_time" &&
        events[i + 1].type != EventType::NULL_VAL) {
      EXPECT_EQ(events[i + 1].type, EventType::STRING) << "reading_time must be parsed as a string, not a number";
    }
    // tags is an object, despite the docs describing a list.
    if (events[i].type == EventType::KEY && events[i].value == "tags") {
      EXPECT_EQ(events[i + 1].type, EventType::OBJECT_START) << "tags must be parsed as an object, not an array";
    }
  }

  // reading_progress is a 0..1 fraction and is always present.
  EXPECT_GE(countKey(events, "reading_progress"), 1u);
}

// Unicode must survive chunking. A 64-byte boundary will land mid-sequence in
// this fixture, which is exactly the case that breaks naive byte handling.
TEST(ReadwiseContract, UnicodeSurvivesChunkBoundaries) {
  const std::string json = loadFixture("list_unicode.json");
  const std::vector<Event> reference = parseChunked(json, json.size());
  const std::vector<Event> chunked = parseChunked(json, 3);
  EXPECT_EQ(reference, chunked);

  const std::string title = valueAfterKey(chunked, "title");
  EXPECT_NE(title.find("\xe6\x97\xa5"), std::string::npos) << "expected CJK to round-trip through the parser";
}

// The API emits no tombstone: after a delete, the document is simply absent
// from an updatedAfter window that spans the deletion, and a direct fetch by id
// returns count 0 rather than 404. Incremental sync therefore cannot observe
// deletions, which is why reconciliation needs a full sweep.
TEST(ReadwiseContract, DeletionLeavesNoTombstone) {
  const std::vector<Event> events = parseChunked(loadFixture("delete_then_list.json"), 64);

  size_t countKeys = 0;
  std::vector<std::string> counts;
  for (size_t i = 0; i + 1 < events.size(); ++i) {
    if (events[i].type == EventType::KEY && events[i].value == "count") {
      counts.push_back(events[i + 1].value);
      ++countKeys;
    }
  }
  ASSERT_EQ(countKeys, 3u) << "expected before_delete, after_delete, by_deleted_id";
  EXPECT_EQ(counts[0], "1") << "throwaway document should be present before deletion";
  EXPECT_EQ(counts[1], "0") << "deleted document must be absent, with no tombstone marker";
  EXPECT_EQ(counts[2], "0") << "fetching a deleted id must yield an empty result, not an error";
}

// A single article body exceeds the parser's 512-byte token buffer by two
// orders of magnitude, and the overflow path does not truncate — it suppresses
// the value callback outright (StreamingJsonParser.cpp:242), so the key arrives
// with no value event behind it at all.
//
// This is silent data loss, not a parse failure, and it is the single most
// important constraint phase 4 inherits: any field longer than 512 bytes is
// invisible to a client built on today's parser. That includes `summary`, which
// was observed up to 2093 bytes on real documents, so it is not exclusively an
// html_content problem.
//
// The test pins the current behaviour deliberately. When issue #4 adds a
// streaming string sink, this test should start failing and be rewritten to
// assert the full body is delivered.
TEST(ReadwiseContract, OversizedStringsAreSilentlyDroppedByTodaysParser) {
  const std::string json = loadFixture("list_oversized_content.json");
  ASSERT_GT(json.size(), 50u * 1024u) << "fixture should retain a full-size article body";

  bool error = false;
  const std::vector<Event> events = parseChunked(json, 64, &error);
  EXPECT_FALSE(error) << "oversized tokens must not put the parser into an error state";

  // The key is short enough to survive; the value that follows it is not.
  ASSERT_EQ(countKey(events, "html_content"), 1u);
  for (size_t i = 0; i + 1 < events.size(); ++i) {
    if (events[i].type == EventType::KEY && events[i].value == "html_content") {
      EXPECT_NE(events[i + 1].type, EventType::STRING)
          << "expected the oversized value to be dropped entirely, so the next "
             "event is structural or the following key. If a STRING now "
             "follows, the parser gained streaming string support and "
             "docs/readwise-api-contract.md plus this test must be updated.";
    }
  }
}

// The 429 body carries the retry delay in the payload as well as the header,
// and the header name is lowercase on the wire.
TEST(ReadwiseContract, RateLimitResponseCarriesRetryDelay) {
  const std::vector<Event> events = parseChunked(loadFixture("error_429.json"), 64);
  EXPECT_EQ(valueAfterKey(events, "retry_after_header"), "16");
  EXPECT_NE(valueAfterKey(events, "detail").find("throttled"), std::string::npos);
}

TEST(ReadwiseContract, AuthFailureBodyIsParseable) {
  const std::vector<Event> events = parseChunked(loadFixture("error_401.json"), 64);
  EXPECT_EQ(valueAfterKey(events, "detail"), "Invalid token.");
}

// POST /api/v2/highlights/ contract, from probe section 13. The response is a
// per-book array whose modified_highlights list carries the created ids; a
// byte-identical re-POST answers with the SAME book and an EMPTY
// modified_highlights — server-side dedup. That emptiness is load-bearing: the
// firmware marks a record uploaded with a non-atomic one-byte patch, and a
// torn patch re-sends the highlight on the next sync, which this behaviour
// makes harmless.
TEST(ReadwiseContract, HighlightCreateDedupsIdenticalRePost) {
  const std::vector<Event> events = parseChunked(loadFixture("highlights_create.json"), 64);

  // Fixture order: first_create, redundant_create, text_only_create.
  ASSERT_EQ(countKey(events, "modified_highlights"), 3u);

  std::vector<size_t> elementCounts;
  for (size_t i = 0; i + 1 < events.size(); ++i) {
    if (events[i].type != EventType::KEY || events[i].value != "modified_highlights") {
      continue;
    }
    ASSERT_EQ(events[i + 1].type, EventType::ARRAY_START);
    size_t count = 0;
    for (size_t j = i + 2; j < events.size() && events[j].type != EventType::ARRAY_END; ++j) {
      ++count;
    }
    elementCounts.push_back(count);
  }
  ASSERT_EQ(elementCounts.size(), 3u);
  EXPECT_EQ(elementCounts[0], 1u) << "first create must report the created highlight id";
  EXPECT_EQ(elementCounts[1], 0u) << "identical re-POST must dedup to an empty modified_highlights";
  EXPECT_EQ(elementCounts[2], 1u) << "text-only create must still create a highlight";
}
